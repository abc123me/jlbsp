## configs/ultrazed_defconfig
```kconfig
BR2_aarch64=y

BR2_TOOLCHAIN_BUILDROOT=y
BR2_TOOLCHAIN_BUILDROOT_GLIBC=y
BR2_TOOLCHAIN_BUILDROOT_CXX=y

BR2_TOOLCHAIN_BARE_METAL_BUILDROOT=y
BR2_TOOLCHAIN_BARE_METAL_BUILDROOT_ARCH="microblazeel-buildroot-elf"

BR2_KERNEL_HEADERS_6_12=y
BR2_GCC_VERSION_14_X=y

BR2_GLOBAL_PATCH_DIR="board/xilinx/patches"
BR2_DOWNLOAD_FORCE_CHECK_HASHES=y
BR2_ROOTFS_POST_BUILD_SCRIPT="board/zynqmp/post-build.sh"
BR2_ROOTFS_POST_IMAGE_SCRIPT="board/zynqmp/post-image.sh"
BR2_ROOTFS_POST_SCRIPT_ARGS="ttyPS0,115200 mmcblk1p2"
BR2_ROOTFS_POST_FAKEROOT_SCRIPT="$(BR2_EXTERNAL_JLBSP_PATH)/support/install-dtbos.sh"
BR2_ROOTFS_POST_FAKEROOT_SCRIPT+="$(BR2_EXTERNAL_JLBSP_PATH)/support/install-fpga.sh"
BR2_ROOTFS_OVERLAY="$(BR2_EXTERNAL_JLBSP_PATH)/board/ultrazed/skeleton"
BR2_ROOTFS_DEVICE_TABLE="$(BR2_EXTERNAL_JLBSP_PATH)/board/ultrazed/skeleton.txt"

BR2_LINUX_KERNEL=y
BR2_LINUX_KERNEL_CUSTOM_TARBALL=y
BR2_LINUX_KERNEL_CUSTOM_TARBALL_LOCATION="$(call github,Xilinx,linux-xlnx,xlnx_rebase_v6.12_LTS_merge_6.12.40)/xlnx_rebase_v6.12_LTS_merge_6.12.40.tar.gz"
BR2_LINUX_KERNEL_USE_CUSTOM_CONFIG=y
BR2_LINUX_KERNEL_CUSTOM_CONFIG_FILE="$(BR2_EXTERNAL_JLBSP_PATH)/board/ultrazed/linux.config"
BR2_LINUX_KERNEL_DTS_SUPPORT=y
BR2_LINUX_KERNEL_INTREE_DTS_NAME="xilinx/ultrazed-linux"
BR2_LINUX_KERNEL_CUSTOM_DTS_DIR="$(BR2_EXTERNAL_JLBSP_PATH)/board/ultrazed/dts"
BR2_LINUX_KERNEL_NEEDS_HOST_OPENSSL=y
BR2_LINUX_KERNEL_DTB_OVERLAY_SUPPORT=y


BR2_TARGET_ROOTFS_EXT2=y
BR2_TARGET_ROOTFS_EXT2_4=y
# BR2_TARGET_ROOTFS_TAR is not set

BR2_TARGET_ARM_TRUSTED_FIRMWARE=y
BR2_TARGET_ARM_TRUSTED_FIRMWARE_CUSTOM_TARBALL=y
BR2_TARGET_ARM_TRUSTED_FIRMWARE_CUSTOM_TARBALL_LOCATION="$(call github,Xilinx,arm-trusted-firmware,xlnx_rebase_v2.12_2025.1)/xlnx_rebase_v2.12_2025.1.tar.gz"
BR2_TARGET_ARM_TRUSTED_FIRMWARE_PLATFORM="zynqmp"
BR2_TARGET_ARM_TRUSTED_FIRMWARE_BL31_UBOOT=y

BR2_TARGET_UBOOT=y
BR2_TARGET_UBOOT_BUILD_SYSTEM_KCONFIG=y
BR2_TARGET_UBOOT_CUSTOM_TARBALL=y
BR2_TARGET_UBOOT_CUSTOM_TARBALL_LOCATION="$(call github,Xilinx,u-boot-xlnx,xlnx_rebase_v2025.01_2025.1)/xlnx_rebase_v2025.01_2025.1.tar.gz"
BR2_TARGET_UBOOT_USE_CUSTOM_CONFIG=y
BR2_TARGET_UBOOT_CUSTOM_CONFIG_FILE="$(BR2_EXTERNAL_JLBSP_PATH)/board/ultrazed/uboot.config"
BR2_TARGET_UBOOT_NEEDS_DTC=y
BR2_TARGET_UBOOT_NEEDS_OPENSSL=y
BR2_TARGET_UBOOT_NEEDS_GNUTLS=y
BR2_TARGET_UBOOT_NEEDS_UTIL_LINUX=y
BR2_TARGET_UBOOT_NEEDS_ATF_BL31=y
BR2_TARGET_UBOOT_USE_BINMAN=y
BR2_TARGET_UBOOT_FORMAT_ITB=y
BR2_TARGET_UBOOT_FORMAT_QSPI_BIN=y
BR2_TARGET_UBOOT_SPL=y
BR2_TARGET_UBOOT_SPL_NAME="spl/boot.bin"
BR2_TARGET_UBOOT_CUSTOM_DTS_PATH="$(BR2_EXTERNAL_JLBSP_PATH)/board/ultrazed/dts/xilinx/zynqmp-ultrazed.dtsi"
BR2_TARGET_UBOOT_CUSTOM_DTS_PATH+="$(BR2_EXTERNAL_JLBSP_PATH)/board/ultrazed/dts/xilinx/ultrazed-uboot.dts"
BR2_TARGET_UBOOT_CUSTOM_MAKEOPTS="DEVICE_TREE=ultrazed-uboot"
BR2_TARGET_UBOOT_ZYNQMP=y
BR2_TARGET_UBOOT_ZYNQMP_PMUFW_EMBEDDEDSW=y
BR2_TARGET_UBOOT_ZYNQMP_PM_CFG="$(BR2_EXTERNAL_JLBSP_PATH)/board/ultrazed/fpga/pm_cfg_obj.c"

BR2_TARGET_XILINX_EMBEDDEDSW=y
BR2_TARGET_XILINX_EMBEDDEDSW_ZYNQMP_PMUFW=y

BR2_PACKAGE_HOST_DOSFSTOOLS=y
BR2_PACKAGE_HOST_GENIMAGE=y
BR2_PACKAGE_HOST_MTOOLS=y
```

## packages/bad-apple-frames/Config.in
```kconfig
config BR2_PACKAGE_BAD_APPLE_FRAMES
	bool "Bad Apple files"
	default n
	help
	  Files for playing / showing the popular bad apple video / soundtrack

if BR2_PACKAGE_BAD_APPLE_FRAMES

config BR2_PACKAGE_BAD_APPLE_FRAMES_INSTALL_PATH
	string "Bad apple files install location"
	default "/usr/share/bad-apple"
	help
	  The path where the files are installed

config BR2_PACKAGE_BAD_APPLE_FRAMES_FRAME_DATA
	bool "Frame files for bad apple"
	default y
	help
	  Each frame is stored as a JPEG

	  There are 6571 frames and they start counting at 1

config BR2_PACKAGE_BAD_APPLE_FRAMES_AUDIO_TRACK
	bool "Audio track for bad apple"
	default y
	help
	  Adds a music.mp3 file containing the bad apple soundtrack

endif
```

## packages/bad-apple-rs/Config.in
```kconfig
config BR2_PACKAGE_BAD_APPLE_RS
	bool "Bad Apple using FBGL-RS"
	default n
	depends on BR2_PACKAGE_HOST_RUSTC_TARGET_ARCH_SUPPORTS
	select BR2_PACKAGE_BAD_APPLE_FRAMES
	select BR2_PACKAGE_HOST_RUSTC
	help
	  Bad Apple but uses my fbgl graphics library

	  https://github.com/abc123me/bad-apple-rs
```

## packages/bpi-wifi-fw/Config.in
```kconfig
config BR2_PACKAGE_BPI_WIFI_FW
	bool "BananaPi WiFi Firmware"
	help
	  This is a package that adds magic firmware blobs
	  used by the BananaPi, see github for more info
```

## packages/btop/Config.in
```kconfig
config BR2_PACKAGE_BTOP
	bool "btop (better top)"
	default n
	help
	  Resource monitor that shows usage and stats for processor,
	  memory, disks, network and processes.
```

## packages/dma-screen-test/Config.in
```kconfig
config BR2_PACKAGE_DMA_SCREEN_TEST
	bool "DMA Screen test"
	default n
	help
	  Userspace app that uses /dev/mem to tes the DMA screen driver
```

## packages/doom-ascii/Config.in
```kconfig
config BR2_PACKAGE_DOOM_ASCII
	bool "doom-ascii"
	help
	  Text-based DOOM in your terminal!

	  doom-ascii is a source port of doomgeneric that renders the
	  game using ASCII characters, Unicode block elements, or
	  Unicode braille patterns, drawn with ANSI escape codes. It
	  has no external library dependencies (no SDL, no ncurses)
	  and has no sound.

	  You will need to separately provide a DOOM IWAD file (game
	  data), e.g. the freely redistributable doom1.wad shareware
	  IWAD, and place it where the game can find it at runtime
	  (its own directory, or a directory pointed to by the
	  DOOMWADDIR environment variable). The IWAD is not
	  distributed by this package.

	  https://github.com/wojciech-graj/doom-ascii
```

## packages/driver-74hc595/Config.in
```kconfig
config BR2_PACKAGE_DRIVER_74HC595
	bool "driver-74hc595"
	default n
	help
	  This is a kernel driver to bit-bang a shift register

	  It is probably completely unecessary nowadays but since 
	  I already wrote it I now have to use it
```

## packages/driver-ddmafb/Config.in
```kconfig
config BR2_PACKAGE_DRIVER_DDMAFB
	bool "driver-ddmafb"
	depends on BR2_LINUX_KERNEL
	default n
	help
	  This is a kernel driver to drive displays via an AXI DMA
```

## packages/fbgl-rs/Config.in
```kconfig
config BR2_PACKAGE_FBGL_RS
	bool "Rust based framebuffer graphics library"
	default n
	depends on BR2_PACKAGE_HOST_RUSTC_TARGET_ARCH_SUPPORTS
	select BR2_PACKAGE_HOST_RUSTC
	help
	  Rewrite of my fbgl graphics library in rust, now with even more features!

	  https://github.com/abc123me/fbgl-rs
```

## packages/jl-secret-keys/Config.in
```kconfig
config BR2_PACKAGE_JL_SECRET_KEYS
	bool "Secrets and keys"
	default n
	help
	  Secret keys, wifi passwords, etc used by me

if BR2_PACKAGE_JL_SECRET_KEYS

config BR2_PACKAGE_JL_SECRET_KEYS_LESS_EVIL_WIFI
	bool "Less evil wifi WPA supplicant"
	default n
	help
	  WPA supplicant files for connecting to less-evil-wifi

config BR2_PACKAGE_JL_SECRET_KEYS_DEV
	bool "Private keys for development usage"
	default y
	help
	  Private keys for generic development usage
	  These will be overwritten if any other keys are enabled

config BR2_PACKAGE_JL_SECRET_KEYS_NTP
	bool "Private keys for NTP server"
	default n
	help
	  Private keys for NTP server

config BR2_PACKAGE_JL_SECRET_KEYS_TDISP
	bool "Private keys for time display"
	default n
	help
	  Private keys for time display

config BR2_PACKAGE_JL_SECRET_KEYS_LED_ALARM
	bool "Private keys for led alarm clock"
	default n
	help
	  Private keys for led alarm clock

config BR2_PACKAGE_JL_SECRET_KEYS_GITEA_RUNNER
	bool "Private keys for gitea runner"
	default n
	help
	  Private keys for gitea runner

config BR2_PACKAGE_JL_SECRET_KEYS_THINKPAD_390E
	bool "Private keys for thinkpad 390e"
	default n
	help
	  Private keys for thinkpad 390e

config BR2_PACKAGE_JL_SECRET_KEYS_WG_PROXY
	bool "Private VPN and SSH keys for wireguard proxy"
	default n
	help
	  Private SSH keys for wireguard proxy

config BR2_PACKAGE_JL_SECRET_KEYS_SCREEN_HAT
	bool "Private keys for screen hat"
	default n
	help
	  Private SSH keys for screen hat

endif
```

## packages/led-alarm/Config.in
```kconfig
config BR2_PACKAGE_LED_ALARM
	bool "LED alarm clock"
	depends on BR2_PACKAGE_RPI_WS281X && BR2_PACKAGE_LIBCONFIG && BR2_PACKAGE_HOST_PKGCONF
	default n
	help
	  This is the userspace time display app for running
	  my led alarm clock

if BR2_PACKAGE_LED_ALARM

config BR2_PACKAGE_LED_ALARM_WEB
	bool "Web interface"
	depends on BR2_PACKAGE_PHP && BR2_PACKAGE_LIBCONFIG_RW
	default y
	help
	  This is the web interface for the led alarm

endif
```

## packages/libconfig-rw/Config.in
```kconfig
config BR2_PACKAGE_LIBCONFIG_RW
	bool "libconfig-rw tool"
	depends on BR2_PACKAGE_LIBCONFIG
	default n
	help
	  Simple C utility for reading / writing to libconfig configuration files

	  Made for my led-alarm as I need some way to parse libconfig configurations via PHP

	  https://github.com/abc123me/libconfig-rw
```

## packages/rpi-ws281x-rust/Config.in
```kconfig
config BR2_PACKAGE_RPI_WS281X_RUST
	bool "Rust library for the WS281X"
	depends on BR2_PACKAGE_HOST_RUSTC_TARGET_ARCH_SUPPORTS
	select BR2_PACKAGE_HOST_RUSTC
	help
	  Userspace Raspberry Pi library for controlling WS281X LEDs.
```

## packages/rpi-ws281x/Config.in
```kconfig
config BR2_PACKAGE_RPI_WS281X
	bool "C library for the WS281X"
	select BR2_PACKAGE_HOST_PKGCONF
	select BR2_PACKAGE_HOST_CMAKE
	default n
	help
	  Userspace Raspberry Pi library for controlling WS281X LEDs.
```

## packages/screen-hat-rs/Config.in
```kconfig
config BR2_PACKAGE_SCREEN_HAT_RS
	bool "Screen Hat animations using FBGL-RS"
	default n
	depends on BR2_PACKAGE_HOST_RUSTC_TARGET_ARCH_SUPPORTS
	select BR2_PACKAGE_HOST_RUSTC
	help
	  Screen hat rust app

	  https://github.com/abc123me/screen-hat-rs
```

## packages/time-display/Config.in
```kconfig
config BR2_PACKAGE_TIME_DISPLAY
	bool "time-display"
	help
	  This is the userspace time display app for driving
	  the 74HC595s running the Datachron 3000 panel
```

## packages/tty-resize/Config.in
```kconfig
config BR2_PACKAGE_TTY_RESIZE
	bool "TTY resize app"
	default y
	help
	  Simple app to resize a TTY
```
